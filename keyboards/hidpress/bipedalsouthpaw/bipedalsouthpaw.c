#include "quantum.h"
#include "bipedalsouthpaw_shared.h"

extern enum pointing_device_mode current_mode;
extern int actuation;

#define ACTUATION_DISPLAY_DURATION 1000  // Show for 1 second


#ifdef OLED_ENABLE

// Layer state arrays
static const char PROGMEM default_layer_on_mouse[] = {
    0x80, 0x81, 0x82, 0x83, 0x84, 0x85, 0x86, 0x87, 0x88, 0x89, 0x8A, 0x8B, 0x8C, 0x8D, 0x8E, 0x8F, 0x90, 0x31, 0x32, 0x93, 0x94,
    0xA0, 0xA1, 0xA2, 0xA3, 0xA4, 0xA5, 0xA6, 0xA7, 0xA8, 0xA9, 0xAA, 0xAB, 0xAC, 0xAD, 0xAE, 0xAF, 0xB0, 0x51, 0x52, 0xB3, 0xB4,
    0xC0, 0xC1, 0xC2, 0xC3, 0xC4, 0xC5, 0xC6, 0xC7, 0xC8, 0xC9, 0xCA, 0xCB, 0xCC, 0xCD, 0xCE, 0xCF, 0xD0, 0x71, 0x72, 0xD3, 0xD4, 0x00
};

static const char PROGMEM default_layer_on_scroll[] = {
    0x20, 0x21, 0x22, 0x23, 0x84, 0x85, 0x86, 0x87, 0x88, 0x89, 0x8A, 0x8B, 0x8C, 0x8D, 0x8E, 0x8F, 0x90, 0x31, 0x32, 0x93, 0x94,
    0x40, 0x41, 0x42, 0x43, 0xA4, 0xA5, 0xA6, 0xA7, 0xA8, 0xA9, 0xAA, 0xAB, 0xAC, 0xAD, 0xAE, 0xAF, 0xB0, 0x51, 0x52, 0xB3, 0xB4,
    0x60, 0x61, 0x62, 0x63, 0xC4, 0xC5, 0xC6, 0xC7, 0xC8, 0xC9, 0xCA, 0xCB, 0xCC, 0xCD, 0xCE, 0xCF, 0xD0, 0x71, 0x72, 0xD3, 0xD4, 0x00
};

static const char PROGMEM default_layer_on_keycodes[] = {
    0x95, 0x96, 0x97, 0x98, 0x84, 0x85, 0x86, 0x87, 0x88, 0x89, 0x8A, 0x8B, 0x8C, 0x8D, 0x8E, 0x8F, 0x90, 0x31, 0x32, 0x93, 0x94,
    0xB5, 0xB6, 0xB7, 0xB8, 0xA4, 0xA5, 0xA6, 0xA7, 0xA8, 0xA9, 0xAA, 0xAB, 0xAC, 0xAD, 0xAE, 0xAF, 0xB0, 0x51, 0x52, 0xB3, 0xB4,
    0xD5, 0xD6, 0xD7, 0xD8, 0xC4, 0xC5, 0xC6, 0xC7, 0xC8, 0xC9, 0xCA, 0xCB, 0xCC, 0xCD, 0xCE, 0xCF, 0xD0, 0x71, 0x72, 0xD3, 0xD4, 0x00
};

static const char PROGMEM one_layer_on_mouse[] = {
    0x80, 0x81, 0x82, 0x83, 0x84, 0x85, 0x86, 0x87, 0x88, 0x89, 0x8A, 0x8B, 0x8C, 0x8D, 0x2E, 0x2F, 0x90, 0x91, 0x92, 0x93, 0x94,
    0xA0, 0xA1, 0xA2, 0xA3, 0xA4, 0xA5, 0xA6, 0xA7, 0xA8, 0xA9, 0xAA, 0xAB, 0xAC, 0xAD, 0x4E, 0x4F, 0xB0, 0xB1, 0xB2, 0xB3, 0xB4,
    0xC0, 0xC1, 0xC2, 0xC3, 0xC4, 0xC5, 0xC6, 0xC7, 0xC8, 0xC9, 0xCA, 0xCB, 0xCC, 0xCD, 0x6E, 0x6F, 0xD0, 0xD1, 0xD2, 0xD3, 0xD4, 0x00
};

static const char PROGMEM one_layer_on_scroll[] = {
    0x20, 0x21, 0x22, 0x23, 0x84, 0x85, 0x86, 0x87, 0x88, 0x89, 0x8A, 0x8B, 0x8C, 0x8D, 0x2E, 0x2F, 0x90, 0x91, 0x92, 0x93, 0x94,
    0x40, 0x41, 0x42, 0x43, 0xA4, 0xA5, 0xA6, 0xA7, 0xA8, 0xA9, 0xAA, 0xAB, 0xAC, 0xAD, 0x4E, 0x4F, 0xB0, 0xB1, 0xB2, 0xB3, 0xB4,
    0x60, 0x61, 0x62, 0x63, 0xC4, 0xC5, 0xC6, 0xC7, 0xC8, 0xC9, 0xCA, 0xCB, 0xCC, 0xCD, 0x6E, 0x6F, 0xD0, 0xD1, 0xD2, 0xD3, 0xD4, 0x00
};

static const char PROGMEM one_layer_on_keycodes[] = {
    0x95, 0x96, 0x97, 0x98, 0x84, 0x85, 0x86, 0x87, 0x88, 0x89, 0x8A, 0x8B, 0x8C, 0x8D, 0x2E, 0x2F, 0x90, 0x91, 0x92, 0x93, 0x94,
    0xB5, 0xB6, 0xB7, 0xB8, 0xA4, 0xA5, 0xA6, 0xA7, 0xA8, 0xA9, 0xAA, 0xAB, 0xAC, 0xAD, 0x4E, 0x4F, 0xB0, 0xB1, 0xB2, 0xB3, 0xB4,
    0xD5, 0xD6, 0xD7, 0xD8, 0xC4, 0xC5, 0xC6, 0xC7, 0xC8, 0xC9, 0xCA, 0xCB, 0xCC, 0xCD, 0x6E, 0x6F, 0xD0, 0xD1, 0xD2, 0xD3, 0xD4, 0x00
};

static const char PROGMEM two_layer_on_mouse[] = {
    0x80, 0x81, 0x82, 0x83, 0x84, 0x85, 0x86, 0x87, 0x88, 0x89, 0x8A, 0x2B, 0x2C, 0x8D, 0x8E, 0x8F, 0x90, 0x91, 0x92, 0x93, 0x94,
    0xA0, 0xA1, 0xA2, 0xA3, 0xA4, 0xA5, 0xA6, 0xA7, 0xA8, 0xA9, 0xAA, 0x4B, 0x4C, 0xAD, 0xAE, 0xAF, 0xB0, 0xB1, 0xB2, 0xB3, 0xB4,
    0xC0, 0xC1, 0xC2, 0xC3, 0xC4, 0xC5, 0xC6, 0xC7, 0xC8, 0xC9, 0xCA, 0x6B, 0x6C, 0xCD, 0xCE, 0xCF, 0xD0, 0xD1, 0xD2, 0xD3, 0xD4, 0x00
};

static const char PROGMEM two_layer_on_scroll[] = {
    0x20, 0x21, 0x22, 0x23, 0x84, 0x85, 0x86, 0x87, 0x88, 0x89, 0x8A, 0x2B, 0x2C, 0x8D, 0x8E, 0x8F, 0x90, 0x91, 0x92, 0x93, 0x94,
    0x40, 0x41, 0x42, 0x43, 0xA4, 0xA5, 0xA6, 0xA7, 0xA8, 0xA9, 0xAA, 0x4B, 0x4C, 0xAD, 0xAE, 0xAF, 0xB0, 0xB1, 0xB2, 0xB3, 0xB4,
    0x60, 0x61, 0x62, 0x63, 0xC4, 0xC5, 0xC6, 0xC7, 0xC8, 0xC9, 0xCA, 0x6B, 0x6C, 0xCD, 0xCE, 0xCF, 0xD0, 0xD1, 0xD2, 0xD3, 0xD4, 0x00
};

static const char PROGMEM two_layer_on_keycodes[] = {
    0x95, 0x96, 0x97, 0x98, 0x84, 0x85, 0x86, 0x87, 0x88, 0x89, 0x8A, 0x2B, 0x2C, 0x8D, 0x8E, 0x8F, 0x90, 0x91, 0x92, 0x93, 0x94,
    0xB5, 0xB6, 0xB7, 0xB8, 0xA4, 0xA5, 0xA6, 0xA7, 0xA8, 0xA9, 0xAA, 0x4B, 0x4C, 0xAD, 0xAE, 0xAF, 0xB0, 0xB1, 0xB2, 0xB3, 0xB4,
    0xD5, 0xD6, 0xD7, 0xD8, 0xC4, 0xC5, 0xC6, 0xC7, 0xC8, 0xC9, 0xCA, 0x6B, 0x6C, 0xCD, 0xCE, 0xCF, 0xD0, 0xD1, 0xD2, 0xD3, 0xD4, 0x00
};

static const char PROGMEM three_layer_on_mouse[] = {
    0x80, 0x81, 0x82, 0x83, 0x84, 0x85, 0x86, 0x87, 0x28, 0x29, 0x8A, 0x8B, 0x8C, 0x8D, 0x8E, 0x8F, 0x90, 0x91, 0x92, 0x93, 0x94,
    0xA0, 0xA1, 0xA2, 0xA3, 0xA4, 0xA5, 0xA6, 0xA7, 0x48, 0x49, 0xAA, 0xAB, 0xAC, 0xAD, 0xAE, 0xAF, 0xB0, 0xB1, 0xB2, 0xB3, 0xB4,
    0xC0, 0xC1, 0xC2, 0xC3, 0xC4, 0xC5, 0xC6, 0xC7, 0x68, 0x69, 0xCA, 0xCB, 0xCC, 0xCD, 0xCE, 0xCF, 0xD0, 0xD1, 0xD2, 0xD3, 0xD4, 0x00
};

static const char PROGMEM three_layer_on_scroll[] = {
    0x20, 0x21, 0x22, 0x23, 0x84, 0x85, 0x86, 0x87, 0x28, 0x29, 0x8A, 0x8B, 0x8C, 0x8D, 0x8E, 0x8F, 0x90, 0x91, 0x92, 0x93, 0x94,
    0x40, 0x41, 0x42, 0x43, 0xA4,0xA5, 0xA6, 0xA7, 0x48, 0x49, 0xAA, 0xAB, 0xAC, 0xAD, 0xAE, 0xAF, 0xB0, 0xB1, 0xB2, 0xB3, 0xB4,
    0x60, 0x61, 0x62, 0x63, 0xC4, 0xC5, 0xC6, 0xC7, 0x68, 0x69, 0xCA, 0xCB, 0xCC, 0xCD, 0xCE, 0xCF, 0xD0, 0xD1, 0xD2, 0xD3, 0xD4, 0x00
};

static const char PROGMEM three_layer_on_keycodes[] = {
    0x95, 0x96, 0x97, 0x98, 0x84, 0x85, 0x86, 0x87, 0x28, 0x29, 0x8A, 0x8B, 0x8C, 0x8D, 0x8E, 0x8F, 0x90, 0x91, 0x92, 0x93, 0x94,
    0xB5, 0xB6, 0xB7, 0xB8, 0xA4, 0xA5, 0xA6, 0xA7, 0x48, 0x49, 0xAA, 0xAB, 0xAC, 0xAD, 0xAE, 0xAF, 0xB0, 0xB1, 0xB2, 0xB3, 0xB4,
    0xD5, 0xD6, 0xD7, 0xD8, 0xC4, 0xC5, 0xC6, 0xC7, 0x68, 0x69, 0xCA, 0xCB, 0xCC, 0xCD, 0xCE, 0xCF, 0xD0, 0xD1, 0xD2, 0xD3, 0xD4, 0x00
};

// Actuation level arrays
static const char PROGMEM actuation_level_1[] = {
    0x1F, 0x1F, 0x1F, 0x1F, 0x1F, 0x1F, 0x1F, 0x1F, 0x1F, 0x1F, 0x1F, 0x1F, 0x9E, 0x1F, 0x84, 0x85, 0x86, 0x1F, 0x1F, 0x1F, 0x1F,
    0x1F, 0x1F, 0x1F, 0x1F, 0x1F, 0x1F, 0x1F, 0x1F, 0x1F, 0x1F, 0x99, 0x1F, 0xBE, 0x1F, 0xA4, 0xA5, 0xA6, 0x1F, 0x1F, 0x1F, 0x1F,
    0x1F, 0x1F, 0x1F, 0x1F, 0x1F, 0x1F, 0x1F, 0x1F, 0x1F, 0x1F, 0x1F, 0x1F, 0xDE, 0x1F, 0xC4, 0xC5, 0xC6, 0x1F, 0x1F, 0x1F, 0x1F, 0x00
};

static const char PROGMEM actuation_level_2[] = {
    0x1F, 0x1F, 0x1F, 0x1F, 0x1F, 0x1F, 0x1F, 0x1F, 0x1F, 0x1F, 0x1F, 0x1F, 0x9E, 0x1F, 0x84, 0x85, 0x86, 0x1F, 0x1F, 0x1F, 0x1F,
    0x1F, 0x1F, 0x1F, 0x1F, 0x1F, 0x1F, 0x1F, 0x1F, 0x1F, 0x1F, 0xB9, 0x1F, 0xBE, 0x1F, 0xA4, 0xA5, 0xA6, 0x1F, 0x1F, 0x1F, 0x1F,
    0x1F, 0x1F, 0x1F, 0x1F, 0x1F, 0x1F, 0x1F, 0x1F, 0x1F, 0x1F, 0x1F, 0x1F, 0xDE, 0x1F, 0xC4, 0xC5, 0xC6, 0x1F, 0x1F, 0x1F, 0x1F, 0x00
};

static const char PROGMEM actuation_level_3[] = {
    0x1F, 0x1F, 0x1F, 0x1F, 0x1F, 0x1F, 0x1F, 0x1F, 0x1F, 0x1F, 0x1F, 0x1F, 0x9E, 0x1F, 0x84, 0x85, 0x86, 0x1F, 0x1F, 0x1F, 0x1F,
    0x1F, 0x1F, 0x1F, 0x1F, 0x1F, 0x1F, 0x1F, 0x1F, 0x1F, 0x1F, 0xD9, 0x1F, 0xBE, 0x1F, 0xA4, 0xA5, 0xA6, 0x1F, 0x1F, 0x1F, 0x1F,
    0x1F, 0x1F, 0x1F, 0x1F, 0x1F, 0x1F, 0x1F, 0x1F, 0x1F, 0x1F, 0x1F, 0x1F, 0xDE, 0x1F, 0xC4, 0xC5, 0xC6, 0x1F, 0x1F, 0x1F, 0x1F, 0x00
};

static const char PROGMEM actuation_level_4[] = {
    0x1F, 0x1F, 0x1F, 0x1F, 0x1F, 0x1F, 0x1F, 0x1F, 0x1F, 0x1F, 0x1F, 0x1F, 0x9E, 0x1F, 0x84, 0x85, 0x86, 0x1F, 0x1F, 0x1F, 0x1F,
    0x1F, 0x1F, 0x1F, 0x1F, 0x1F, 0x1F, 0x1F, 0x1F, 0x1F, 0x1F, 0x9A, 0x1F, 0xBE, 0x1F, 0xA4, 0xA5, 0xA6, 0x1F, 0x1F, 0x1F, 0x1F,
    0x1F, 0x1F, 0x1F, 0x1F, 0x1F, 0x1F, 0x1F, 0x1F, 0x1F, 0x1F, 0x1F, 0x1F, 0xDE, 0x1F, 0xC4, 0xC5, 0xC6, 0x1F, 0x1F, 0x1F, 0x1F, 0x00
};

static const char PROGMEM actuation_level_5[] = {
    0x1F, 0x1F, 0x1F, 0x1F, 0x1F, 0x1F, 0x1F, 0x1F, 0x1F, 0x1F, 0x1F, 0x1F, 0x9E, 0x1F, 0x84, 0x85, 0x86, 0x1F, 0x1F, 0x1F, 0x1F,
    0x1F, 0x1F, 0x1F, 0x1F, 0x1F, 0x1F, 0x1F, 0x1F, 0x1F, 0x1F, 0xBA, 0x1F, 0xBE, 0x1F, 0xA4, 0xA5, 0xA6, 0x1F, 0x1F, 0x1F, 0x1F,
    0x1F, 0x1F, 0x1F, 0x1F, 0x1F, 0x1F, 0x1F, 0x1F, 0x1F, 0x1F, 0x1F, 0x1F, 0xDE, 0x1F, 0xC4, 0xC5, 0xC6, 0x1F, 0x1F, 0x1F, 0x1F, 0x00
};

// Layer state rendering function
void render_layer_state(void) {
    uint8_t layer = get_highest_layer(layer_state);

    switch(layer) {
        case _DEFAULT:
            switch(current_mode) {
                case MODE_MOUSE:
                    oled_write_P(default_layer_on_mouse, false);
                    break;
                case MODE_SCROLLING:
                    oled_write_P(default_layer_on_scroll, false);
                    break;
                case MODE_CUSTOM_KEYS:
                    oled_write_P(default_layer_on_keycodes, false);
                    break;
                default:
                    oled_write_P(PSTR("MODE: UNKNOWN\n"), false);
                    break;
            }
            break;
        case _ONE:
            switch(current_mode) {
                case MODE_MOUSE:
                    oled_write_P(one_layer_on_mouse, false);
                    break;
                case MODE_SCROLLING:
                    oled_write_P(one_layer_on_scroll, false);
                    break;
                case MODE_CUSTOM_KEYS:
                    oled_write_P(one_layer_on_keycodes, false);
                    break;
                default:
                    oled_write_P(PSTR("LAYER 1: UNKNOWN MODE\n"), false);
                    break;
            }
            break;
        case _TWO:
            switch(current_mode) {
                case MODE_MOUSE:
                    oled_write_P(two_layer_on_mouse, false);
                    break;
                case MODE_SCROLLING:
                    oled_write_P(two_layer_on_scroll, false);
                    break;
                case MODE_CUSTOM_KEYS:
                    oled_write_P(two_layer_on_keycodes, false);
                    break;
                default:
                    oled_write_P(PSTR("LAYER 2: UNKNOWN MODE\n"), false);
                    break;
            }
            break;
        case _THREE:
            switch(current_mode) {
                case MODE_MOUSE:
                    oled_write_P(three_layer_on_mouse, false);
                    break;
                case MODE_SCROLLING:
                    oled_write_P(three_layer_on_scroll, false);
                    break;
                case MODE_CUSTOM_KEYS:
                    oled_write_P(three_layer_on_keycodes, false);
                    break;
                default:
                    oled_write_P(PSTR("LAYER 3: UNKNOWN MODE\n"), false);
                    break;
            }
            break;
        default:
            oled_write_P(PSTR("LAYER: UNKNOWN\n"), false);
            break;
    }
}

uint32_t actuation_display_timer = 0;
bool showing_actuation = false;

void render_actuation_state(void) {
    switch(actuation) {
        case 64:  
            oled_write_P(actuation_level_5, false);
            break;
        case 128:  
            oled_write_P(actuation_level_4, false);
            break;
        case 256:  // State 3 (default)
            oled_write_P(actuation_level_3, false);
            break;
        case 320:  
            oled_write_P(actuation_level_2, false);
            break;
        case 352:  
            oled_write_P(actuation_level_1, false);
            break;
        default:
            oled_write_P(actuation_level_3, false);
            break;
    }
}

bool oled_task_user(void) {
    static bool was_showing_actuation = false;

    if (showing_actuation) {
        // If we just started showing actuation
        if (!was_showing_actuation) {
            oled_clear();
            was_showing_actuation = true;
        }

        if (timer_elapsed32(actuation_display_timer) > ACTUATION_DISPLAY_DURATION) {
            showing_actuation = false;
            was_showing_actuation = false;
            oled_clear();
            render_layer_state();
        } else {
            render_actuation_state();
        }
    } else {
        if (was_showing_actuation) {
            oled_clear();
            was_showing_actuation = false;
        }
        render_layer_state();
    }
    
    return false;
}

#endif